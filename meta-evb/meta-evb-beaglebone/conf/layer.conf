## meta-evb/meta-evb-beaglebone/conf/layer.conf
```bitbake
BBPATH .= ":${LAYERDIR}"

BBFILES += "\
${LAYERDIR}/recipes-*/*/*.bb \
${LAYERDIR}/recipes-*/*/*.bbappend \
"

BBFILE_COLLECTIONS += "evb-beaglebone"
BBFILE_PATTERN_evb-beaglebone = "^${LAYERDIR}/"
BBFILE_PRIORITY_evb-beaglebone = "6"
LAYERDEPENDS_evb-beaglebone = "yoctobsp phosphor-layer"
LAYERSERIES_COMPAT_evb-beaglebone = "wrynose blacksail"
```
